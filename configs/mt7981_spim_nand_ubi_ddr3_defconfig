## plat/mediatek/mt7987/Config.in
```kconfig
# SPDX-License-Identifier: BSD-3-Clause
#
# Copyright (c) 2026 Yuzhii0718 <admin@yuzhii0718.eu.org>
#
# MT7987 platform-specific configurations
#

if _PLAT_MT7987

config _ENABLE_I2P5G_PHY
	bool "Enable internal 2.5G PHY support"
	default y
	select _SUPPORTS_I2P5G_PHY

choice
	prompt "Internal 2.5G PHY mode"
	depends on _SUPPORTS_I2P5G_PHY
	default _I2P5G_PHY_1P2L

	config _I2P5G_PHY_1P2L
		bool "1 port 2 lane"

	config _I2P5G_PHY_2P1L
		bool "2 port 1 lane"

endchoice

config I2P5G_PHY_MODE
	int
	default 0 if _I2P5G_PHY_1P2L
	default 1 if _I2P5G_PHY_2P1L

choice
    prompt "MT7987 ARMPLL frequency (MHz)"
    depends on _PLAT_MT7987
	default MT7987_ARMPLL_FREQ_2000

config MT7987_ARMPLL_FREQ_1600
	bool "1600 MHz"
config MT7987_ARMPLL_FREQ_1700
	bool "1700 MHz"
config MT7987_ARMPLL_FREQ_1800
	bool "1800 MHz"
config MT7987_ARMPLL_FREQ_1900
	bool "1900 MHz"
config MT7987_ARMPLL_FREQ_2000
    bool "2000 MHz (default)"
config MT7987_ARMPLL_FREQ_2100
    bool "2100 MHz"
config MT7987_ARMPLL_FREQ_2200
    bool "2200 MHz"
config MT7987_ARMPLL_FREQ_2300
    bool "2300 MHz"
config MT7987_ARMPLL_FREQ_2400
    bool "2400 MHz"
config MT7987_ARMPLL_FREQ_2500
    bool "2500 MHz"

endchoice

# Makefile/C option bridge for MT7987 ARMPLL frequency selection.
config MT7987_ARMPLL_FREQ_MHZ
	int
	depends on _PLAT_MT7987
	default 1600 if MT7987_ARMPLL_FREQ_1600
	default 1700 if MT7987_ARMPLL_FREQ_1700
	default 1800 if MT7987_ARMPLL_FREQ_1800
	default 1900 if MT7987_ARMPLL_FREQ_1900
	default 2000 if MT7987_ARMPLL_FREQ_2000
	default 2100 if MT7987_ARMPLL_FREQ_2100
	default 2200 if MT7987_ARMPLL_FREQ_2200
	default 2300 if MT7987_ARMPLL_FREQ_2300
	default 2400 if MT7987_ARMPLL_FREQ_2400
	default 2500 if MT7987_ARMPLL_FREQ_2500

endif # _PLAT_MT7987
```
