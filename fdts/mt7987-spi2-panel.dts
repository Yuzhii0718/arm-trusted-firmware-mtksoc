// SPDX-License-Identifier: (GPL-2.0+ OR BSD-3-Clause)
/*
 * Copyright (c) 2026, OpenWrt.org
 */
#include "mt7987-spi2.dts"

/ {
	soc {
		/*
		 * Placed after qspi so mtk_qspi_init(), which takes the first
		 * "mediatek,ipm-spi" it finds, still lands on the boot flash.
		 */
		lcd: spi@11008800 {
			compatible = "mediatek,ipm-spi";
			#address-cells = <1>;
			#size-cells = <0>;
			reg = <0x11008800 0x1000>;
			status = "okay";

			panel@0 {
				compatible = "sitronix,st7789p3";
				reg = <0>;
				spi-cpol = <1>;
				spi-cpha = <1>;
				tick-dly = <2>;
				sample-sel = <0>;
				spi-max-frequency = <52000000>;
			};
		};
	};
};
