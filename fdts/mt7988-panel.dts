// SPDX-License-Identifier: (GPL-2.0+ OR BSD-3-Clause)
/*
 * Copyright (c) 2026, OpenWrt.org
 */
/dts-v1/;

/ {
	soc {
		#address-cells = <1>;
		#size-cells = <1>;

		lcd: spi@11008000 {
			compatible = "mediatek,ipm-spi";
			#address-cells = <1>;
			#size-cells = <0>;
			reg = <0x11008000 0x1000>;
			status = "okay";

			panel@0 {
				compatible = "sitronix,st7789p3";
				reg = <0>;
				spi-cpol = <1>;
				spi-cpha = <1>;
				tick-dly = <2>;
				sample-sel = <0>;
				spi-max-frequency = <52000000>;
			};
		};
	};
};
